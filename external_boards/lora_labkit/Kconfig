## external_boards/lora_labkit/Kconfig
```kconfig
# Copyright (c) 2024 ???
#
# This file is subject to the terms and conditions of the GNU Lesser
# General Public License v2.1. See the file LICENSE in the top level
# directory for more details.

config BOARD
    default "lora_labkit" if BOARD_LORA_LABKIT

config BOARD_LORA_LABKIT
    bool
    default y
    select CPU_MODEL_STM32WLE5CC

    # Put defined MCU peripherals here (in alphabetical order)
    select HAS_PERIPH_UART

    # Put other features for this board (in alphabetical order)
```
